## drivers/can/Kconfig.stm32fd
```kconfig
# STM32 CAN configuration options

# Copyright (c) 2020 Alexander Wachter
# SPDX-License-Identifier: Apache-2.0

DT_COMPAT_STM32_FDCAN := st,stm32-fdcan

config CAN_STM32FD
	bool "STM32 FDCAN driver"
	default $(dt_compat_enabled,$(DT_COMPAT_STM32_FDCAN))
	select CAN_MCAN
	select USE_STM32_LL_RCC

if CAN_STM32FD

config CAN_MAX_STD_ID_FILTER
	int "Maximum number of std ID filters"
	default 28
	range 0 28
	help
	  Defines the maximum number of filters with standard ID (11-bit)
	  that can be attached.

config CAN_MAX_EXT_ID_FILTER
	int "Maximum number of ext ID filters"
	default 8
	range 0 8
	help
	  Defines the maximum number of filters with extended ID (29-bit)
	  that can be attached.

config CAN_CKDIV
	int "CKDIV register value"
	range 0 15
	default 0
	help
	  This value is written to the CKDIV register.
	  The APB clock is divided according to this value before it is feed to
	  CAN core. Note that the the divider affects all CAN controllers.
	  The values of the register are multiplied by two and zero corresponds
	  to one. The value six, for example results in a clock divided by 12.

endif #CAN_STM32FD
```

## tests/subsys/canbus/isotp/implementation/testcase.yaml
```yaml
tests:
  can.isotp.implementation:
    tags: can isotp
    depends_on: can
    extra_configs:
      - CONFIG_CAN_FD_MODE=n          # CAN-FD must be forced off for this test
  can.isotp.implementation.fd64:
    tags: can canfd isotp
    depends_on: canfd
    extra_configs:
      - CONFIG_CAN_FD_MODE=y
      - CONFIG_CAN_MAX_DLEN=64
      - CONFIG_ISOTP_RX_BUF_COUNT=8
      - CONFIG_ISOTP_RX_BUF_SIZE=126
```
